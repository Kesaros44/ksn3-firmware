## config/boards/shields/ksn_3/Kconfig.defconfig
```kconfig
if SHIELD_KSN_3_LEFT || SHIELD_KSN_3_RIGHT

config ZMK_KEYBOARD_NAME
    default "KSN3"

config ZMK_SPLIT
    default y

endif
```

## config/boards/shields/ksn_3/Kconfig.shield
```kconfig
config SHIELD_KSN_3_LEFT
    def_bool $(shields_list_contains,ksn_3_left)

config SHIELD_KSN_3_RIGHT
    def_bool $(shields_list_contains,ksn_3_right)
```
